## Config.in
```kconfig
source "$BR2_EXTERNAL/package/mistify/ansible/Config.in"
source "$BR2_EXTERNAL/package/mistify/aufs-util/Config.in"
source "$BR2_EXTERNAL/package/mistify/aufs/Config.in"
source "$BR2_EXTERNAL/package/mistify/beanstalkd/Config.in"
source "$BR2_EXTERNAL/package/mistify/ca-certificates-bundle/Config.in"
source "$BR2_EXTERNAL/package/mistify/confd/Config.in"
source "$BR2_EXTERNAL/package/mistify/docker-docker/Config.in"
source "$BR2_EXTERNAL/package/mistify/etcd/Config.in"
source "$BR2_EXTERNAL/package/mistify/hlibnl/Config.in.host"
source "$BR2_EXTERNAL/package/mistify/hyajl/Config.in.host"
source "$BR2_EXTERNAL/package/mistify/ipxe/Config.in"
source "$BR2_EXTERNAL/package/mistify/libcontainer/Config.in"
source "$BR2_EXTERNAL/package/mistify/libvirt/Config.in"
source "$BR2_EXTERNAL/package/mistify/lochness-ansible/Config.in"
source "$BR2_EXTERNAL/package/mistify/lochness/Config.in"
source "$BR2_EXTERNAL/package/mistify/mistify-agent-docker/Config.in"
source "$BR2_EXTERNAL/package/mistify/mistify-agent-image/Config.in"
source "$BR2_EXTERNAL/package/mistify/mistify-agent-libvirt/Config.in"
source "$BR2_EXTERNAL/package/mistify/mistify-agent/Config.in"
source "$BR2_EXTERNAL/package/mistify/mistify-image-service/Config.in"
source "$BR2_EXTERNAL/package/mistify/openvswitch/Config.in"
source "$BR2_EXTERNAL/package/mistify/python-paramiko/Config.in"
source "$BR2_EXTERNAL/package/mistify/python-pyyaml/Config.in"
source "$BR2_EXTERNAL/package/mistify/queensland/Config.in"
source "$BR2_EXTERNAL/package/mistify/spl/Config.in"
source "$BR2_EXTERNAL/package/mistify/statsd/Config.in"
source "$BR2_EXTERNAL/package/mistify/zfs/Config.in"

comment "-----------------------------------------------"
comment "Select variant below. Default variant is \"base\""
comment "-----------------------------------------------"
config BR2_VARIANT_DEV
	bool "Mistify Development image (variant = dev)"
	default n
	help
		Generate a MistifyOS Development image which includes development
		tools such as GCC, GoLang, header files, and supporting bits.
```

## package/mistify/ansible/Config.in
```kconfig
config BR2_PACKAGE_ANSIBLE
        bool "ansible"
	select BR2_PACAKGE_PYTHON_HTTPLIB2
	select BR2_PACAKGE_PYTHON_PARAMIKO
	select BR2_PACAKGE_PYTHON_PYYAML
	select BR2_PACAKGE_PYTHON_JINJA2
	depends on BR2_PACKAGE_PYTHON_PY_PYC
        help
	  Ansible is an IT automation tool. It can configure systems, deploy
	  software, and orchestrate more advanced IT tasks such as continuous
	  deployments or zero downtime rolling updates.

	  http://www.ansible.com/
```

## package/mistify/aufs-util/Config.in
```kconfig
config BR2_PACKAGE_AUFS_UTIL
        bool "aufs-util"
	depends on BR2_LINUX_KERNEL_EXT_AUFS
	depends on BR2_PACKAGE_AUFS
        help
	  Userland utilities for administrating AUFS

          http://aufs.sourceforge.net/
```

## package/mistify/aufs/Config.in
```kconfig
config BR2_PACKAGE_AUFS
        bool "aufs"
	depends on BR2_LINUX_KERNEL_EXT_AUFS
        help
          The native Linux kernel port of the AuFS filesystem. 

          http://aufs.sourceforge.net/
```

## package/mistify/beanstalkd/Config.in
```kconfig
config BR2_PACKAGE_BEANSTALKD
        bool "beanstalkd"
        help
	  Beanstalk is a simple, fast work queue.

	  Its interface is generic, but was originally designed for reducing the
	  latency of page views in high-volume web applications by running
	  time-consuming tasks asynchronously.

	  http://kr.github.io/beanstalkd/
```

## package/mistify/ca-certificates-bundle/Config.in
```kconfig
config BR2_PACKAGE_CA_CERTIFICATES_BUNDLE
	bool "CA Certificates bundle"
	depends on BR2_PACKAGE_CA_CERTIFICATES
	help
	  This package builds a "bundle" file of CA certificates
	  for applications that cannot use the individual files.
```

## package/mistify/confd/Config.in
```kconfig
config BR2_PACKAGE_CONFD
        bool "confd"
        help
          CoreOS confd

	  https://github.com/kelseyhightower/confd
```

## package/mistify/debianutils/Config.in
```kconfig
config BR2_PACKAGE_DEBIANUTILS
        bool "debianutils"
        help
          Debian's debianutils suite. 
```

## package/mistify/docker-docker/Config.in
```kconfig
config BR2_PACKAGE_DOCKER_DOCKER
        bool "docker-docker"
        select BR2_PACKAGE_LIBCONTAINER
        help
          Docker container framework
          
          Container API and framework from Docker.

          https://github.com/docker/docker
```

## package/mistify/docker-io/Config.in
```kconfig
config BR2_PACKAGE_DOCKER_IO
        bool "docker-io"
        help
          Docker container framework
          
	  Container API and framework from Docker.

          https://github.com/docker/docker
          
```

## package/mistify/etcd/Config.in
```kconfig
config BR2_PACKAGE_ETCD
        bool "etcd"
        help
          CoreOS etcd

	  https://coreos.com/using-coreos/etcd/
```

## package/mistify/go/Config.in.host
```kconfig
config BR2_PACKAGE_HOST_GO
        bool "go"
        help
          The GO language. 
          
          This is a host side package needed to compile go programs for the
          target.

          http://golang.org/
          
```

## package/mistify/hlibnl/Config.in.host
```kconfig
config BR2_PACKAGE_HOST_HLIBNL
	bool "Host side libnl tools."
	depends on BR2_TOOLCHAIN_HAS_THREADS
	help
	  A library for applications dealing with netlink socket.
	  This builds the host side tools needed to build other target components.

	  http://people.suug.ch/~tgr/libnl/

if BR2_PACKAGE_HOST_HLIBNL

config BR2_PACKAGE_HOST_LIBNL_TOOLS
	bool "install tools"
	# uses <dlfcn.h>
	depends on !BR2_PREFER_STATIC_LIB
	help
	  Install host side binary tools.

comment "libnl tools need a toolchain w/ dynamic library"
	depends on BR2_PREFER_STATIC_LIB
endif

comment "libnl needs a toolchain w/ threads"
	depends on !BR2_TOOLCHAIN_HAS_THREADS
```

## package/mistify/hyajl/Config.in.host
```kconfig
config BR2_PACKAGE_HOST_YAJL
	bool "Host side yajl library and includes"
	help
	  Yet Another JSON Library. YAJL is a small event-driven
	  (SAX-style) JSON parser written in ANSI C, and a small
	  validating JSON generator.
	  
	  NOTE: This installs the host side components in order to build other
	  components which are dependant upon yajl.

	  http://lloyd.github.com/yajl/
```

## package/mistify/ifupdown/Config.in
```kconfig
config BR2_PACKAGE_IFUPDOWN
        bool "ifupdown"
        help
          Debian's ifupdown suite. 
```

## package/mistify/ipxe/Config.in
```kconfig
config BR2_PACKAGE_IPXE
	bool "ipxe"
	help
		iPXE is the leading open source network boot firmware. It provides
		a full PXE implementation enhanced with additional features.

		http://ipxe.org/
```

## package/mistify/libcontainer/Config.in
```kconfig
config BR2_PACKAGE_LIBCONTAINER
        bool "libcontainer"
        help
          libcontainer container management API
          
          Go API for container management from Docker.

          https://github.com/docker/libcontainer
          
```

## package/mistify/libvirt/Config.in
```kconfig
comment "libvirt requires a toolchain with WCHAR, THREADS and LARGEFILE support"
    depends on !BR2_USE_WCHAR || !BR2_LARGEFILE || !BR2_TOOLCHAIN_HAS_THREADS

config BR2_PACKAGE_LIBVIRT
	bool "libvirt"
	depends on BR2_USE_WCHAR                    # gnutls
	depends on BR2_USE_MMU                      # lvm2
	depends on BR2_TOOLCHAIN_HAS_THREADS        # libnl
	select BR2_PACKAGE_GETTEXT
	select BR2_PACKAGE_GNUTLS
	select BR2_PACKAGE_YAJL
	select BR2_PACKAGE_LVM2
	select BR2_PACKAGE_HOST_HLIBNL
	select BR2_PACKAGE_HOST_YAJL
	select BR2_PACKAGE_LIBNL
	select BR2_PACKAGE_LIBXML2
	select BR2_PACKAGE_LIBGCRYPT
	help
	  libvirt is a toolkit to interact with the virtualization
	  capabilities of recent versions of Linux (and other OSes).

	  http://libvirt.org/
```

## package/mistify/lochness-ansible/Config.in
```kconfig
config BR2_PACKAGE_LOCHNESS_ANSIBLE
        bool "Ansible scripts for Lochness"
        help
          https://github.com/mistifyio/lochness-ansible
          
```

## package/mistify/lochness/Config.in
```kconfig
config BR2_PACKAGE_LOCHNESS
        bool "lochness"
        help
          The LochNess Mistify-OS variation. 
          
          Loch Ness is a simple virtual machine manager ("cloud controller").
          It is a proof-of-concept, straight forward implementation for testing
          various ideas. It is targeted at clusters of up to 100 physical
          machines.

          https://github.com/mistifyio/lochness
          
```

## package/mistify/mistify-agent-docker/Config.in
```kconfig
config BR2_PACKAGE_MISTIFY_AGENT_DOCKER
        bool "mistify-agent-docker"
         select BR2_PACKAGE_DOCKER_DOCKER
         select BR2_PACKAGE_MISTIFY_AGENT
        help
          The Mistify Docker Sub-Agent

          https://github.com/mistifyio/mistify-agent-docker
```

## package/mistify/mistify-agent-image/Config.in
```kconfig
config BR2_PACKAGE_MISTIFY_AGENT_IMAGE
        bool "mistify-agent-image"
        select BR2_PACKAGE_MISTIFY_AGENT
        help
          The Mistify Image Sub-Agent
          
          https://github.com/mistifyio/mistify-agent-image
          
```

## package/mistify/mistify-agent-libvirt/Config.in
```kconfig
config BR2_PACKAGE_MISTIFY_AGENT_LIBVIRT
        bool "mistify-agent-libvirt"
        select BR2_PACKAGE_HOST_GO
        select BR2_PACKAGE_RUNIT
        select BR2_PACKAGE_LIBVIRT
         select BR2_PACKAGE_MISTIFY_AGENT
        help
          The Mistify Libvirt Sub-Agent
          
          https://github.com/mistifyio/mistify-agent-libvirt
          
```

## package/mistify/mistify-agent-ovs/Config.in
```kconfig
config BR2_PACKAGE_MISTIFY_AGENT_OVS
        bool "mistify-agent-ovs"
         select BR2_PACKAGE_OVS_OVS
         select BR2_PACKAGE_MISTIFY_AGENT
        help
          The Mistify OVS Sub-Agent

          https://github.com/mistifyio/mistify-agent-ovs
```

## package/mistify/mistify-agent/Config.in
```kconfig
config BR2_PACKAGE_MISTIFY_AGENT
        bool "mistify-agent"
        help
          The Mistify Agent. 
          
          This agent is used to manage .....

          https://github.com/mistifyio/mistify-agent
          
```
