## package/mistify/mistify-etcd/Config.in
```kconfig
config BR2_PACKAGE_MISTIFY_ETCD
        bool "mistify-etcd"
        help
          CoreOS etcd

	  https://coreos.com/using-coreos/etcd/
```

## package/mistify/mistify-image-service/Config.in
```kconfig
config BR2_PACKAGE_MISTIFY_IMAGE_SERVICE
        bool "mistify-image-service"
        help
          The Mistify Image Service

          https://github.com/mistifyio/mistify-image-service
```

## package/mistify/perl-forks/Config.in
```kconfig
config BR2_PACKAGE_PERL_FORKS
	bool "perl-forks"
	help
	  Simple API for threading.
```

## package/mistify/python-paramiko/Config.in
```kconfig
config BR2_PACKAGE_PYTHON_PARAMIKO
	bool "python-paramiko"
	select BR2_PACKAGE_PYTHON_MARKUPSAFE # runtime
	select BR2_PACKAGE_PYTHON_PYCRYPTO
	help
	  "paramiko" is a combination of the esperanto words for "paranoid" and
	  "friend".  it's a module for python 2.6+ that implements the SSH2 protocol
	  for secure (encrypted and authenticated) connections to remote machines.

	  https://github.com/paramiko/paramiko/
```

## package/mistify/python-pyyaml/Config.in
```kconfig
config BR2_PACKAGE_PYTHON_PYYAML
	bool "python-pyyaml"
	select BR2_PACKAGE_PYTHON_MARKUPSAFE # runtime
	select BR2_PACKAGE_LIBYAML
	help
	  PyYAML features a complete YAML 1.1 parser, Unicode support,
	  pickle support, capable extension API, and sensible error messages.
	  PyYAML supports standard YAML tags and provides Python-specific tags
	  that allow to represent an arbitrary Python object.

	  http://pyyaml.org/wiki/PyYAML
```

## package/mistify/queensland/Config.in
```kconfig
config BR2_PACKAGE_QUEENSLAND
        bool "queensland"
	select etcd
        help
          
```

## package/mistify/runit/Config.in
```kconfig
config BR2_PACKAGE_RUNIT
	bool "runit"
	help
	  runit is a cross-platform Unix init scheme with service supervision
```

## package/mistify/sdk-autoconf/Config.in
```kconfig
config BR2_PACKAGE_SDK_AUTOCONF
	bool "sdk-autoconf"
	select BR2_PACKAGE_SDK_M4
	select BR2_PACKAGE_PERL
	select BR2_PACKAGE_PERL_THREADS
	help
	  Extensible program for developing configure scripts.  These
	  scripts handle all the mundane system/feature detection.

	  http://www.gnu.org/software/autoconf/
```

## package/mistify/sdk-automake/Config.in
```kconfig
config BR2_PACKAGE_SDK_AUTOMAKE
	bool "sdk-automake"
	select BR2_PACKAGE_SDK_AUTOCONF
	select BR2_PACKAGE_PERL
	help
	  Tool for automatically generating Makefile's for input to
	  configure scripts (made by autoconf).

	  http://www.gnu.org/software/automake/
```

## package/mistify/sdk-flex/Config.in
```kconfig
config BR2_PACKAGE_SDK_FLEX
	bool "sdk-flex"
	select BR2_PACKAGE_GETTEXT if BR2_NEEDS_GETTEXT_IF_LOCALE
	help
	  A fast lexical analyser generator. A tool for generating
	  programs that perform pattern-matching on text.

	  http://flex.sourceforge.net/
```

## package/mistify/sdk-overrides/Config.in
```kconfig
config BR2_PACKAGE_SDK_OVERRIDES
	bool "sdk-overrides"
	help
	  A series of variable and macro overrides needed to build the SDK
	  version of Mistify-OS.
```

## package/mistify/start-stop-daemon/Config.in
```kconfig
config BR2_PACKAGE_START_STOP_DAEMON
        bool "start-stop-daemon"
        help
          Debian's start-stop-daemon from the dpkg suite. 
```

## package/mistify/statsd/Config.in
```kconfig
config BR2_PACKAGE_STATSD
        bool "statsd"
        select BR2_PACKAGE_NODEJS
	help
	  A network daemon that runs on the Node.js platform and listens for 
	  statistics, like counters and timers, sent over UDP or TCP and sends 
	  aggregates to one or more pluggable backend services (e.g., Graphite).

          https://github.com/etsy/statsd/
          
```

## package/mistify/zfs/Config.in
```kconfig
config BR2_PACKAGE_ZFS
        bool "zfs"
        select BR2_PACKAGE_SPL
        help
          The native Linux kernel port of the ZFS filesystem. 
          
          ZFS is a highly scalable future proof file system and logical volume
          manager designed around a few key concepts:
            - Data integrity is paramount.
            - Storage administration should be simple.
            - Everything can be done online.

          http://zfsonlinux.org/
```

## variants/dev-mistify_defconfig
```kconfig
BR2_VARIANT_DEV=y
BR2_PACKAGE_APR=y
BR2_PACKAGE_APR_UTIL=y
BR2_PACKAGE_NEON=y
BR2_PACKAGE_NEON_ZLIB=y
BR2_PACKAGE_NEON_SSL=y
BR2_PACKAGE_NEON_XML=y
BR2_PACKAGE_NEON_LIBXML2=y
BR2_PACKAGE_SUBVERSION=y
BR2_PACKAGE_LIBTOOL=y
BR2_PACKAGE_MAKE=y
BR2_PACKAGE_GIT=y
BR2_PACKAGE_BINUTILS=y
BR2_PACKAGE_BINUTILS_TARGET=y
BR2_PACKAGE_GDB=y
# BR2_PACKAGE_GDB_SERVER is not set
BR2_PACKAGE_GDB_DEBUGGER=y
# BR2_PACKAGE_GDB_TUI is not set
# BR2_PACKAGE_GDB_PYTHON is not set
BR2_GDB_VERSION="7.8.2"
```

## variants/sdk-mistify_defconfig
```kconfig
BR2_PACKAGE_PERL_FORKS=y
BR2_PACKAGE_SDK_AUTOCONF=y
BR2_PACKAGE_SDK_AUTOMAKE=y
BR2_PACKAGE_SDK_BISON=y
BR2_PACKAGE_SDK_FLEX=y
BR2_PACKAGE_SDK_M4=y
BR2_PACKAGE_SDK_GCC=y
BR2_PACKAGE_SDK_CCACHE=y
BR2_PACKAGE_SDK_TEXINFO=y
BR2_PACKAGE_SDK_OVERRIDES=y
BR2_PACKAGE_LXC=y
BR2_PACKAGE_GETENT=y
BR2_PACKAGE_FILE=y
# BR2_PACKAGE_NTP_NTPTRACE is not set
# BR2_PACKAGE_NTP_NTP_WAIT is not set
BR2_PACKAGE_BC=y
BR2_PACKAGE_NCURSES_TARGET_PANEL=y
BR2_PACKAGE_NCURSES_TARGET_FORM=y
BR2_PACKAGE_NCURSES_TARGET_MENU=y
BR2_PACKAGE_LIBEDIT=y
BR2_PACKAGE_APR=y
BR2_PACKAGE_APR_UTIL=y
BR2_PACKAGE_NEON=y
# BR2_PACKAGE_NEON_ZLIB is not set
# BR2_PACKAGE_NEON_SSL is not set
BR2_PACKAGE_NEON_XML=y
BR2_PACKAGE_NEON_EXPAT=y
# BR2_PACKAGE_NEON_LIBXML2 is not set
BR2_PACKAGE_LIBARCHIVE=y
# BR2_PACKAGE_LIBARCHIVE_BSDTAR is not set
# BR2_PACKAGE_LIBARCHIVE_BSDCPIO is not set
BR2_PACKAGE_PERL=y
BR2_PACKAGE_PERL_MODULES=""
# BR2_PACKAGE_PERL_CRYPT_OPENSSL_RANDOM is not set
# BR2_PACKAGE_PERL_CRYPT_OPENSSL_RSA is not set
# BR2_PACKAGE_PERL_DATETIME_TINY is not set
# BR2_PACKAGE_PERL_DB_FILE is not set
# BR2_PACKAGE_PERL_DIGEST_HMAC is not set
# BR2_PACKAGE_PERL_DIGEST_SHA1 is not set
# BR2_PACKAGE_PERL_ENCODE_DETECT is not set
# BR2_PACKAGE_PERL_ENCODE_LOCALE is not set
# BR2_PACKAGE_PERL_FILE_LISTING is not set
# BR2_PACKAGE_PERL_FILE_UTIL is not set
# BR2_PACKAGE_PERL_GD is not set
# BR2_PACKAGE_PERL_GDGRAPH is not set
# BR2_PACKAGE_PERL_GDTEXTUTIL is not set
# BR2_PACKAGE_PERL_HTML_PARSER is not set
# BR2_PACKAGE_PERL_HTML_TAGSET is not set
# BR2_PACKAGE_PERL_HTTP_COOKIES is not set
# BR2_PACKAGE_PERL_HTTP_DAEMON is not set
# BR2_PACKAGE_PERL_HTTP_DATE is not set
# BR2_PACKAGE_PERL_HTTP_MESSAGE is not set
# BR2_PACKAGE_PERL_HTTP_NEGOTIATE is not set
# BR2_PACKAGE_PERL_IO_HTML is not set
# BR2_PACKAGE_PERL_IO_SOCKET_SSL is not set
# BR2_PACKAGE_PERL_JSON_TINY is not set
# BR2_PACKAGE_PERL_LIBWWW_PERL is not set
# BR2_PACKAGE_PERL_LWP_MEDIATYPES is not set
# BR2_PACKAGE_PERL_MAIL_DKIM is not set
# BR2_PACKAGE_PERL_MAILTOOLS is not set
# BR2_PACKAGE_PERL_MIME_BASE64 is not set
# BR2_PACKAGE_PERL_MOJOLICIOUS is not set
# BR2_PACKAGE_PERL_NET_DNS is not set
# BR2_PACKAGE_PERL_NET_HTTP is not set
# BR2_PACKAGE_PERL_NET_SSLEAY is not set
# BR2_PACKAGE_PERL_NETADDR_IP is not set
# BR2_PACKAGE_PERL_PATH_TINY is not set
# BR2_PACKAGE_PERL_TIME_HIRES is not set
# BR2_PACKAGE_PERL_TIMEDATE is not set
# BR2_PACKAGE_PERL_TRY_TINY is not set
# BR2_PACKAGE_PERL_URI is not set
# BR2_PACKAGE_PERL_WWW_ROBOTRULES is not set
# BR2_PACKAGE_PERL_XML_LIBXML is not set
# BR2_PACKAGE_PERL_XML_NAMESPACESUPPORT is not set
# BR2_PACKAGE_PERL_XML_SAX is not set
# BR2_PACKAGE_PERL_XML_SAX_BASE is not set
BR2_PACKAGE_PYTHON_DOCUTILS=y
BR2_PACKAGE_CPIO=y
BR2_PACKAGE_MERCURIAL=y
BR2_PACKAGE_SUBVERSION=y
BR2_PACKAGE_PKGCONF=y
BR2_PACKAGE_LIBTOOL=y
BR2_PACKAGE_MAKE=y
BR2_PACKAGE_GIT=y
BR2_PACKAGE_GPERF=y
BR2_PACKAGE_CMAKE=y
BR2_PACKAGE_CMAKE_CTEST=y
BR2_PACKAGE_BINUTILS=y
BR2_PACKAGE_BINUTILS_TARGET=y
BR2_PACKAGE_BUSYBOX_CONFIG="$(BR2_EXTERNAL)/configs/mistify-busybox-sdk.config"
BR2_ROOTFS_POST_SCRIPT_ARGS="SDK"
BR2_TARGET_GENERIC_ISSUE="Welcome to Mistify-OS -- SDK"
```
